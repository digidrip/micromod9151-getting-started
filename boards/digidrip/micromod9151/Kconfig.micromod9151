## boards/digidrip/micromod9151/Kconfig.micromod9151
```kconfig
# MicroMod nRF9151 NRF9151 board configuration

# Copyright (c) 2025 Christian Hirsch
# SPDX-License-Identifier: Apache-2.0

config BOARD_MICROMOD9151
	select SOC_NRF9151_LACA
```

## boards/digidrip/micromod_dk/Kconfig.micromod_dk
```kconfig
# MicroMod DK board configuration for the on-board STM32F103TB

# Copyright (c) 2025 Christian Hirsch
# SPDX-License-Identifier: Apache-2.0

config BOARD_MICROMOD_DK
	select SOC_STM32F103XB
```

## boards/shields/digidrip_micromod_dk/Kconfig.shield
```kconfig
# Copyright (c) 2025 Christian Hirsch
# SPDX-License-Identifier: Apache-2.0

config SHIELD_DIGIDRIP_MICROMOD_DK
	def_bool $(shields_list_contains,digidrip_micromod_dk)
```
